## boards/shields/nerdboard/Kconfig.defconfig
```kconfig
if SHIELD_NERDBOARD_LEFT || SHIELD_NERDBOARD_RIGHT

config ZMK_KEYBOARD_NAME
    default "nerdboard"

config ZMK_SPLIT
    default y

endif

if SHIELD_NERDBOARD_RIGHT

config ZMK_SPLIT_ROLE_CENTRAL
    default y

endif
```

## boards/shields/nerdboard/Kconfig.shield
```kconfig
config SHIELD_NERDBOARD_LEFT
    def_bool $(shields_list_contains,nerdboard_left)

config SHIELD_NERDBOARD_RIGHT
    def_bool $(shields_list_contains,nerdboard_right)
```

## config/west.yml
```yaml
manifest:
  defaults:
    revision: v0.3
  remotes:
    - name: zmkfirmware
      url-base: https://github.com/zmkfirmware
    # Additional modules containing boards/shields/custom code can be listed here as well
    # See https://docs.zephyrproject.org/3.2.0/develop/west/manifest.html#projects
    #- name: george-norton
    #  url-base: https://github.com/george-norton
    - name: thelowprokill
      url-base: https://github.com/thelowprokill
  projects:
    - name: zmk
      remote: zmkfirmware
      revision: main
      import: app/west.yml
    - name: zmk-driver-pmw3360
      remote: thelowprokill
    #  remote: george-norton
      revision: main
    #- name: pmw3389_zephyr_driver
    #  remote: thelowprokill
    #  revision: main
  self:
    path: config
```

## dts/bindings/input_processors/zmk,input-processor-rotation.yaml
```yaml
# dts/bindings/input_processors/zmk,input-processor-rotation.yaml
description: Custom 2D Matrix rotation input processor

compatible: "zmk,input-processor-rotation"

include: base.yaml

properties:
  "#input-processor-cells":
    type: int
    const: 0

  type:
    type: int
    required: true

  x-codes:
    type: array
    required: true

  y-codes:
    type: array
    required: true

  matrix:
    type: array
    required: true
```

## dts/bindings/zmk,input-processor-rotate.yaml
```yaml
description: ZMK input processor for arbitrary-angle XY rotation

compatible: "zmk,input-processor-rotate"

include: base.yaml

properties:
  "#input-processor-cells":
    type: int
    const: 0
    required: true
```
